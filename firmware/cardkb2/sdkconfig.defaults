## firmware/cardkb2/sdkconfig.defaults
```kconfig
CONFIG_IDF_TARGET="esp32c61"
CONFIG_BT_ENABLED=y
CONFIG_BT_BLUEDROID_ENABLED=y
CONFIG_BT_BLE_ENABLED=y
CONFIG_BT_HID_ENABLED=y
CONFIG_BT_BLE_42_FEATURES_SUPPORTED=y
CONFIG_ESPTOOLPY_FLASHMODE_DIO=y
CONFIG_ESPTOOLPY_FLASHSIZE_4MB=y
CONFIG_PARTITION_TABLE_CUSTOM=y
CONFIG_PARTITION_TABLE_CUSTOM_FILENAME="partitions.csv"
CONFIG_I2C_ENABLE_SLAVE_DRIVER_VERSION_2=y
CONFIG_MBEDTLS_CERTIFICATE_BUNDLE=y

# Compact, monochrome LVGL labels for the 128x64 SSD1306.
CONFIG_LV_COLOR_DEPTH_1=y
CONFIG_LV_FONT_UNSCII_8=y
CONFIG_LV_USE_THEME_DEFAULT=n
CONFIG_LV_USE_THEME_SIMPLE=n
CONFIG_LV_USE_THEME_MONO=n
CONFIG_LV_BUILD_EXAMPLES=n
CONFIG_LV_MEM_SIZE_KILOBYTES=16
```
